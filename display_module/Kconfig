## display_module/Kconfig
```kconfig
config CUSTOM_DISPLAY
    bool "Custom OLED display module"
    depends on ZMK_DISPLAY
    select LV_USE_CANVAS
    default n

config CUSTOM_DISPLAY_DEFAULT_ON
    bool "Start with custom display active on boot"
    depends on CUSTOM_DISPLAY
    default n

config BT_SWITCH_PERSIST_BASE_LAYER
    bool "Persist per-profile base layer across power cycles"
    depends on CUSTOM_DISPLAY
    select SETTINGS
    default n
    help
      When enabled, the active base layer for each BT profile is saved to NVS
      via Zephyr's settings subsystem and restored on boot. Requires base-layers
      to be set on the bt_switch behavior node in the keymap.

config BT_SWITCH_PERSIST_ACTIVE_PROFILE
    bool "Restore last active BT profile on boot"
    depends on CUSTOM_DISPLAY
    select SETTINGS
    default n
    help
      When enabled, the last active BT profile index is saved to NVS and
      restored on boot, so the keyboard reconnects to the same device it was
      paired with before powering off.
```

## display_module/dts/bindings/zmk,behavior-bt-clear.yaml
```yaml
# Copyright (c) 2024 DreamShark-Bytes
# SPDX-License-Identifier: MIT

description: >
  Clear the current BT profile bond and reset its stored base layer to the
  default. Replaces &bt BT_CLR so profile clears stay consistent with
  per-profile layer memory.

compatible: "zmk,behavior-bt-clear"

include: zero_param.yaml
```

## display_module/dts/bindings/zmk,behavior-bt-switch.yaml
```yaml
# Copyright (c) 2024 DreamShark-Bytes
# SPDX-License-Identifier: MIT

description: >
  Switch BT profile while disconnecting all active host connections first.
  Optionally restores the remembered base layer (e.g. Windows vs Mac) for
  the destination profile.

compatible: "zmk,behavior-bt-switch"

include: one_param.yaml

properties:
  base-layers:
    type: array
    required: false
    description: >
      Ordered list of mutually exclusive OS/layout layer indices. The first
      entry is the always-on bottom layer (e.g. WINDOWS_L = 0); remaining
      entries are toggled on or off when switching profiles. Omit this
      property to disable per-profile layer tracking entirely.
```
