## display_module/dts/bindings/zmk,behavior-cycle.yaml
```yaml
# Copyright (c) 2024 DreamShark-Bytes
# SPDX-License-Identifier: MIT

description: Context-sensitive cycle — advances demo images in DEMO state, pet stats in CUSTOM state

compatible: "zmk,behavior-cycle"

include: zero_param.yaml
```

## display_module/dts/bindings/zmk,behavior-demo-cycle.yaml
```yaml
# Copyright (c) 2024 DreamShark-Bytes
# SPDX-License-Identifier: MIT

description: Cycle through demo images on the custom display screen

compatible: "zmk,behavior-demo-cycle"

include: zero_param.yaml
```

## display_module/dts/bindings/zmk,behavior-display-toggle.yaml
```yaml
# Copyright (c) 2024 DreamShark-Bytes
# SPDX-License-Identifier: MIT

description: Toggle custom display mode on/off

compatible: "zmk,behavior-display-toggle"

include: zero_param.yaml
```
